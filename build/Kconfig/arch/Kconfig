## build/Kconfig/arch/Kconfig
```kconfig
# Load Zephyr Arch Kconfig descriptions.
osource "/home/nhut/zephyrproject/zephyr/arch/tricore/Kconfig"
osource "/home/nhut/zephyrproject/zephyr/arch/hexagon/Kconfig"
osource "/home/nhut/zephyrproject/zephyr/arch/rx/Kconfig"
osource "/home/nhut/zephyrproject/zephyr/arch/x86/Kconfig"
osource "/home/nhut/zephyrproject/zephyr/arch/xtensa/Kconfig"
osource "/home/nhut/zephyrproject/zephyr/arch/sparc/Kconfig"
osource "/home/nhut/zephyrproject/zephyr/arch/riscv/Kconfig"
osource "/home/nhut/zephyrproject/zephyr/arch/posix/Kconfig"
osource "/home/nhut/zephyrproject/zephyr/arch/openrisc/Kconfig"
osource "/home/nhut/zephyrproject/zephyr/arch/mips/Kconfig"
osource "/home/nhut/zephyrproject/zephyr/arch/arm64/Kconfig"
osource "/home/nhut/zephyrproject/zephyr/arch/arm/Kconfig"
osource "/home/nhut/zephyrproject/zephyr/arch/arc/Kconfig"
```

## build/Kconfig/boards/Kconfig
```kconfig
# Load Zephyr board Kconfig descriptions.
osource "/home/nhut/zephyrproject/zephyr/boards/st/stm32f4_disco/Kconfig"
```

## build/Kconfig/boards/Kconfig.defconfig
```kconfig
# Load Zephyr board defconfig descriptions.
osource "/home/nhut/zephyrproject/zephyr/boards/st/stm32f4_disco/Kconfig.defconfig"
```
